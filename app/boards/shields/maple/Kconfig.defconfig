## app/boards/shields/maple/Kconfig.defconfig
```kconfig
# Copyright (c) 2020 The ZMK Contributors
# SPDX-License-Identifier: MIT

if SHIELD_MAPLE_LEFT

config ZMK_KEYBOARD_NAME
	default "Maple"

config ZMK_SPLIT_ROLE_CENTRAL
	default y

endif

if SHIELD_MAPLE_LEFT || SHIELD_MAPLE_RIGHT

config ZMK_SPLIT
	default y

endif
```

## app/boards/shields/maple/Kconfig.shield
```kconfig
# Copyright (c) 2020 The ZMK Contributors
# SPDX-License-Identifier: MIT

config SHIELD_MAPLE_LEFT
	def_bool $(shields_list_contains,maple_left)

config SHIELD_MAPLE_RIGHT
	def_bool $(shields_list_contains,maple_right)
```
